## CMakeLists.txt
```
# SPDX-License-Identifier: Apache-2.0

cmake_minimum_required(VERSION 3.20.0)

get_filename_component(APP_ROOT "${CMAKE_CURRENT_LIST_DIR}/../.." ABSOLUTE)
list(APPEND BOARD_ROOT ${APP_ROOT})

find_package(Zephyr REQUIRED HINTS $ENV{ZEPHYR_BASE})
project(lesson_06_printk_logging)

target_sources(app PRIVATE src/main.c)
```

## Kconfig
```
# SPDX-License-Identifier: Apache-2.0

source "Kconfig.zephyr"

menu "Lesson 06 logging options"

config LESSON_06_LOG_LEVEL
	int "Lesson 06 module log level"
	default 4
	range 0 4
	help
	  Log level used by LOG_MODULE_REGISTER(). 0 disables this module's
	  logging, 1 enables errors, 2 warnings, 3 information and 4 debug.

config LESSON_06_HEARTBEAT_INTERVAL_MS
	int "Heartbeat interval in milliseconds"
	default 1000
	range 100 5000
	help
	  Time between heartbeat LED toggles and log output.

endmenu
```

## prj.conf
```kconfig
# Enable GPIO for a visible heartbeat LED.
CONFIG_GPIO=y

# Enable console output through the board's chosen UART.
CONFIG_SERIAL=y
CONFIG_CONSOLE=y
CONFIG_UART_CONSOLE=y
CONFIG_PRINTK=y

# Enable Zephyr logging on the UART backend.
CONFIG_LOG=y
CONFIG_LOG_MODE_IMMEDIATE=y
CONFIG_LOG_BACKEND_UART=y
CONFIG_LOG_BACKEND_SHOW_COLOR=n
CONFIG_LOG_DEFAULT_LEVEL=3

# Lesson-specific options.
CONFIG_LESSON_06_LOG_LEVEL=4
CONFIG_LESSON_06_HEARTBEAT_INTERVAL_MS=1000
```

## src/main.c
```c
/*
 * SPDX-License-Identifier: Apache-2.0
 */

#include <errno.h>
#include <stdint.h>

#include <zephyr/drivers/gpio.h>
#include <zephyr/kernel.h>
#include <zephyr/logging/log.h>
#include <zephyr/sys/printk.h>

LOG_MODULE_REGISTER(lesson_06, CONFIG_LESSON_06_LOG_LEVEL);

#define LED_NODE DT_ALIAS(led1)

#if !DT_NODE_HAS_STATUS(LED_NODE, okay)
#error "Unsupported board: led1 devicetree alias is not defined"
#endif

static const struct gpio_dt_spec led = GPIO_DT_SPEC_GET(LED_NODE, gpios);

static int configure_gpio(void)
{
	int ret;

	if (!gpio_is_ready_dt(&led)) {
		printk("LED GPIO is not ready\n");
		return -ENODEV;
	}

	ret = gpio_pin_configure_dt(&led, GPIO_OUTPUT_INACTIVE);
	if (ret < 0) {
		printk("Failed to configure LED: %d\n", ret);
		return ret;
	}

	return 0;
}

int main(void)
{
	uint32_t heartbeat = 0U;
	bool led_is_on = false;
	int ret;

	ret = configure_gpio();
	if (ret < 0) {
		return 0;
	}

	printk("Lesson 06: printk and logging\n");
	printk("printk() writes directly to the console path.\n");

	LOG_INF("Logging subsystem is running");
	LOG_INF("Module log level: %d", CONFIG_LESSON_06_LOG_LEVEL);
	LOG_INF("Heartbeat interval: %d ms",
		CONFIG_LESSON_06_HEARTBEAT_INTERVAL_MS);
	LOG_INF("LED: %s pin %u, active %s",
		led.port->name,
		(unsigned int)led.pin,
		led.dt_flags & GPIO_ACTIVE_LOW ? "low" : "high");
	LOG_WRN("This warning is intentional for lesson output");
	LOG_DBG("Debug log is visible because LESSON_06_LOG_LEVEL=4");

	while (1) {
		led_is_on = !led_is_on;
		(void)gpio_pin_set_dt(&led, led_is_on ? 1 : 0);
		heartbeat++;

		LOG_INF("Heartbeat %u: green LED %s",
			(unsigned int)heartbeat,
			led_is_on ? "on" : "off");

		if ((heartbeat % 5U) == 0U) {
			LOG_WRN("Heartbeat reached %u",
				(unsigned int)heartbeat);
		}

		LOG_DBG("Loop iteration complete");

		k_sleep(K_MSEC(CONFIG_LESSON_06_HEARTBEAT_INTERVAL_MS));
	}

	return 0;
}
```
